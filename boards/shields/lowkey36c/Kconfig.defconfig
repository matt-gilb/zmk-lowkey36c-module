## boards/shields/lowkey36c/Kconfig.defconfig
```kconfig
if SHIELD_LOWKEY36C_LEFT

config ZMK_KEYBOARD_NAME
    default "LowKey36c"

config ZMK_SPLIT_ROLE_CENTRAL
    default y

endif

if SHIELD_LOWKEY36C_LEFT || SHIELD_LOWKEY36C_RIGHT

config ZMK_SPLIT
    default y

endif
```

## boards/shields/lowkey36c/Kconfig.shield
```kconfig
config SHIELD_LOWKEY36C_LEFT
    def_bool $(shields_list_contains,lowkey36c_left)

config SHIELD_LOWKEY36C_RIGHT
    def_bool $(shields_list_contains,lowkey36c_right)
```
