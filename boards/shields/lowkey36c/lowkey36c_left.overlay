#include "my_keyboard.dtsi"

&kscan0 {
    row-gpios
        = <&xiao_d 0 GPIO_ACTIVE_HIGH> // row0
        , <&xiao_d 1 GPIO_ACTIVE_HIGH> // row1
        , <&xiao_d 2 GPIO_ACTIVE_HIGH> // row2
        , <&xiao_d 3 GPIO_ACTIVE_HIGH> // row3
        ;
    col-gpios
        = <&xiao_d 5 (GPIO_ACTIVE_HIGH | GPIO_PULL_DOWN)> // col0
        , <&xiao_d 4 (GPIO_ACTIVE_HIGH | GPIO_PULL_DOWN)> // col1
        , <&xiao_d 9 (GPIO_ACTIVE_HIGH | GPIO_PULL_DOWN)> // col2
        , <&xiao_d 8 (GPIO_ACTIVE_HIGH | GPIO_PULL_DOWN)> // col3
        , <&xiao_d 10 (GPIO_ACTIVE_HIGH | GPIO_PULL_DOWN)> // col4
        ;
};
